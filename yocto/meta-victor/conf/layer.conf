## yocto/meta-victor/conf/layer.conf
```bitbake
BBPATH .= ":${LAYERDIR}"
BBFILES += "${LAYERDIR}/recipes-*/*/*.bb ${LAYERDIR}/recipes-*/*/*.bbappend"
BBFILE_COLLECTIONS += "victor"
BBFILE_PATTERN_victor = "^${LAYERDIR}/"
BBFILE_PRIORITY_victor = "10"
LAYERSERIES_COMPAT_victor = "scarthgap kirkstone"
```
